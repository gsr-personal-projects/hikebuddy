## ESP32/components/gui/Kconfig
```kconfig
menu "Memory LCD display"

config LVGL_GUI_ENABLE
    bool "Enable LVGL GUI drivers"
    default y

config WIDTH
    string "Display width in pixels"
    default 400

config HEIGHT
    string "Display height in pixels"
    default 240

config SPIFREQ
    string "SPI frequency in Hz (divisor of 80 Mhz, at most 2 MHz)"
    default 1000000

config FRAMERATE
    string "Frequency of frameuffer flushing in Hz (divisor of 100, at most 5)"
    default 1

endmenu
```

## ESP32/components/hal/Kconfig
```kconfig
menu "HikeBuddy Board"

choice BOARD_REV
    prompt "Board hardware version"
    default HIKEBUDDY_V1
    help
        This option sets the HikeBuddy board revision.

        - Rev1.0.0 Dev: Dhauladhar

config HIKEBUDDY_V1
    bool "Rev1.0.*"
config HIKEBUDDY_NONE
    bool "Plain ESP32"
endchoice

config HIKEBUDDY_INPUT_DEBUG
    bool "Enable input debug messages"
    default n
    help
        Debugging

config HIKEBUDDY_PCA9555_DEBUG
    bool "Enable PCA9555 port-expander debug messages"
    depends on HIKEBUDDY_V1
    default n
    help
        Debugging

config HIKEBUDDY_LCD_DEBUG
    bool "Enable LCD debug messages"
    depends on HIKEBUDDY_V1
    default n
    help
        Debugging

config HIKEBUDDY_POWER_DEBUG
    bool "Enable power/charging debug messages"
    depends on HIKEBUDDY_V1
    default n
    help
        Debugging

endmenu
```
